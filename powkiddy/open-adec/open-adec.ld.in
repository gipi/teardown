/*
 * Copyright 2021 Gianluca Pacchiella <gp@ktln2.org>
 *
 * This file is part of open-adec.
 *
 * open-adec is free software: you can redistribute it and/or modify
 * it under the terms of the GNU General Public License as published by
 * the Free Software Foundation, either version 3 of the License, or
 * (at your option) any later version.
 *
 * open-adec is distributed in the hope that it will be useful,
 * but WITHOUT ANY WARRANTY; without even the implied warranty of
 * MERCHANTABILITY or FITNESS FOR A PARTICULAR PURPOSE.  See the
 * GNU General Public License for more details.
 *
 * You should have received a copy of the GNU General Public License
 * along with open-adec.  If not, see <http://www.gnu.org/licenses/>.
 */
#include <config.h>

MEMORY {
    IRAM (RW) : ORIGIN = ENTRY_ADDRESS, LENGTH = IRAM_SIZE
}

SECTIONS
{
    .text : ALIGN(4)
    {
        *(.startup.text)
        *(.text)
        . = ALIGN(12);
        _ebase = .;
        *(.eirq.text)
        *(.data)
        *(.rodata)
    } > IRAM
    /* 
     * HOW THE FUCK YOU TELL THE LINKER TO NOT INCLUDE
     * THESE FUCKING SECTIONS (NO ONE ASKED ABOUT) IN THE
     * PRECEEDING .text SECTION?
     */
    .porcodio (NOLOAD) :
    {
        *(.reginfo)
        *(.MIPS.abiflags)
    }
}
